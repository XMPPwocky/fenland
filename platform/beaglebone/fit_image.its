## platform/beaglebone/fit_image.its
```
/dts-v1/;

/ {
	description = "Fenland image for the BeagleBone";
	#address-cells = <1>;

	images {
		kernel@1 {
			description = "Fenland kernel";
			data = /incbin/("../../build/kernel/kernel.bin");
			type = "kernel";
			arch = "arm";
			os = "linux";
			compression = "none";
			load = <0x80009000>;
			entry = <0x80009000>;
			hash@1 {
				algo = "crc32";
			};
			hash@2 {
				algo = "sha1";
			};
		};
	};

	configurations {
		default = "config@1";
		config@1 {
			description = "Boot Fenland";
			kernel = "kernel@1";
		};
	};
};
```
